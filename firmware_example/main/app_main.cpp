#include "dl_model_base.hpp"
#include "esp_heap_caps.h"
#include "esp_log.h"
#include "esp_timer.h"
#include <cmath>
#include <cstdint>
#include <memory>
#include <vector>
#include "fixture_config.h"

extern const uint8_t tinyvision_espdl[] asm("_binary_tinyvision_espdl_start");
extern const uint8_t fixture_input[] asm("_binary_fixture_input_bin_start");
extern const uint8_t fixture_end[] asm("_binary_fixture_input_bin_end");
static const char *TAG = "AgriTinyVision";

extern "C" void app_main(void)
{
    ESP_LOGW(TAG, "PENDING HARDWARE VALIDATION; this is one preprocessed train-image fixture, no camera");
    const int64_t load_start = esp_timer_get_time();
    auto model = std::make_unique<dl::Model>((const char *)tinyvision_espdl,
                                            fbs::MODEL_LOCATION_IN_FLASH_RODATA);
    const int64_t load_us = esp_timer_get_time() - load_start;
    auto inputs = model->get_inputs();
    auto outputs = model->get_outputs();
    if (inputs.size() != 1 || outputs.size() != 1) {
        ESP_LOGE(TAG, "UNKNOWN: invalid input/output count");
        return;
    }
    dl::TensorBase *input = inputs.begin()->second;
    dl::TensorBase *output = outputs.begin()->second;
    const std::vector<int> expected_shape = {1, FIXTURE_HEIGHT, FIXTURE_WIDTH, 3};
    const size_t expected_bytes = FIXTURE_HEIGHT * FIXTURE_WIDTH * 3 * sizeof(float);
    if (input->shape != expected_shape || input->dtype != dl::DATA_TYPE_INT8 ||
        output->dtype != dl::DATA_TYPE_INT8 || (size_t)(fixture_end - fixture_input) != expected_bytes ||
        !input->data || !output->data) {
        ESP_LOGE(TAG, "UNKNOWN: shape/dtype/allocation mismatch; inspect actual .info before inference");
        return;
    }
    // Golden input is normalized float32 NHWC, little endian, generated by Python.
    // It is already preprocessed. This does not implement camera decode/resize/quality gate.
    const float *normalized = reinterpret_cast<const float *>(fixture_input);
    int8_t *quantized = static_cast<int8_t *>(input->data);
    for (size_t i = 0; i < expected_bytes / sizeof(float); ++i) {
        quantized[i] = dl::quantize<int8_t>(normalized[i], DL_RESCALE(input->exponent));
    }
    const int64_t start = esp_timer_get_time();
    model->run();
    const int64_t inference_us = esp_timer_get_time() - start;
    int8_t *out = static_cast<int8_t *>(output->data);
    const float normal_logit = dl::dequantize(out[0], DL_SCALE(output->exponent));
    const float suspect_logit = dl::dequantize(out[1], DL_SCALE(output->exponent));
    const float probability = 1.0f / (1.0f + std::exp(normal_logit - suspect_logit));
    // Identical float32 probability/bounds as Python; do not recompute threshold +/- margin.
    const char *state = !FIXTURE_QUALITY_PASSED || !std::isfinite(probability) || probability < 0.0f || probability > 1.0f
                            ? "UNKNOWN" : probability < FIXTURE_NORMAL_UPPER_BOUND ? "NORMAL"
                            : probability < FIXTURE_SUSPECT_LOWER_BOUND ? "UNKNOWN" : "SUSPECT";
    ESP_LOGI(TAG, "fixture result=%s p_suspect=%f fp32_reference=%f", state, probability, FIXTURE_FP32_PROBABILITY);
    ESP_LOGI(TAG, "python_fp32_probability_difference=%f", probability - FIXTURE_FP32_PROBABILITY);
    ESP_LOGI(TAG, "measured on THIS device: load_us=%lld inference_us=%lld", load_us, inference_us);
    ESP_LOGI(TAG, "internal_min_free=%u psram_current_free=%u psram_min_free=%u",
             (unsigned)heap_caps_get_minimum_free_size(MALLOC_CAP_INTERNAL),
             (unsigned)heap_caps_get_free_size(MALLOC_CAP_SPIRAM),
             (unsigned)heap_caps_get_minimum_free_size(MALLOC_CAP_SPIRAM));
    ESP_LOGW(TAG, "These free-heap counters are not peak model RAM. Camera latency, power and complete Gateway memory fit remain pending.");
}
